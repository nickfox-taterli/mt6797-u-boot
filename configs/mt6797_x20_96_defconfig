## configs/mt6797_x20_96_defconfig
```kconfig
CONFIG_ARM=y
CONFIG_COUNTER_FREQUENCY=13000000
CONFIG_POSITION_INDEPENDENT=y
CONFIG_INIT_SP_RELATIVE=y
CONFIG_ARCH_MEDIATEK=y
CONFIG_TARGET_MT6797=y
CONFIG_TEXT_BASE=0x46000000
CONFIG_SYS_MALLOC_LEN=0x800000
CONFIG_SYS_MALLOC_F_LEN=0x4000
CONFIG_NR_DRAM_BANKS=1
CONFIG_MTK_MEM_MAP_DDR_SIZE=0x80000000
CONFIG_DEFAULT_DEVICE_TREE="mt6797-x20-96"
CONFIG_SYS_LOAD_ADDR=0x48000000
# CONFIG_DEBUG_UART is not set
CONFIG_BOARD_EARLY_INIT_F=y
CONFIG_BAUDRATE=921600
CONFIG_DM_SERIAL=y
CONFIG_MTK_SERIAL=y
CONFIG_BOOTDELAY=2
CONFIG_USE_BOOTARGS=y
CONFIG_BOOTARGS="console=ttyS0,921600n8 root=PARTUUID=8273e1ab-846f-4468-b999-ee2ea8e50a16 rootfstype=ext4 rootwait loglevel=7"
CONFIG_USE_BOOTCOMMAND=y
CONFIG_BOOTCOMMAND="run x20_boot"
# CONFIG_BOOTSTD is not set
CONFIG_HUSH_PARSER=y
CONFIG_CMD_BOOTI=y
CONFIG_CMD_MEMORY=y
CONFIG_CMD_CRC32=y
CONFIG_CMD_MMC=y
CONFIG_CMD_PART=y
CONFIG_EFI_PARTITION=y
CONFIG_CMD_EXT4=y
CONFIG_CMD_FAT=y
CONFIG_CMD_FS_GENERIC=y
CONFIG_CMD_DM=y
CONFIG_CMD_LMB=y
CONFIG_CMD_HASH=y
CONFIG_SHA256=y
CONFIG_CMD_LOADB=y
CONFIG_CMD_LOADY=y
CONFIG_CLK=y
CONFIG_MMC_MTK=y
CONFIG_ENV_IS_NOWHERE=y
CONFIG_SYS_PROMPT="X20=> "
# CONFIG_NET is not set
# CONFIG_EFI_LOADER is not set
# CONFIG_VIDEO is not set
# CONFIG_USB is not set
# CONFIG_CMD_FLASH is not set
# CONFIG_CMD_SAVEENV is not set
```

## configs/mt6797_x20_96_spl_defconfig
```kconfig
CONFIG_ARM=y
CONFIG_ARCH_MEDIATEK=y
CONFIG_TARGET_MT6797_SPL=y
CONFIG_SYS_THUMB_BUILD=y
CONFIG_TEXT_BASE=0x46000000
CONFIG_HAS_CUSTOM_SYS_INIT_SP_ADDR=y
CONFIG_CUSTOM_SYS_INIT_SP_ADDR=0x130000
CONFIG_NR_DRAM_BANKS=1
CONFIG_DEFAULT_DEVICE_TREE="mt6797-x20-96"
CONFIG_SYS_LOAD_ADDR=0x48000000
CONFIG_SPL_TEXT_BASE=0x201000
CONFIG_SPL_MAX_SIZE=0x35000
CONFIG_SPL_FOOTPRINT_LIMIT=y
CONFIG_SPL_MAX_FOOTPRINT=0x3f000
CONFIG_SPL_HAVE_INIT_STACK=y
CONFIG_SPL_STACK=0x130000
CONFIG_SPL_STACK_R=y
CONFIG_SPL_STACK_R_ADDR=0x40200000
CONFIG_SPL_SYS_MALLOC_SIMPLE=y
CONFIG_SPL_STACK_R_MALLOC_SIMPLE_LEN=0x100000
CONFIG_SPL_EARLY_BSS=y
CONFIG_SPL_SYS_MALLOC_F_LEN=0x4000
CONFIG_SPL_DM=y
CONFIG_SPL_OF_CONTROL=y
CONFIG_SPL_SERIAL=y
CONFIG_SPL_CLK=y
CONFIG_SPL_MMC=y
CONFIG_SPL_SYS_MMCSD_RAW_MODE=y
CONFIG_SYS_MMCSD_RAW_MODE_U_BOOT_USE_PARTITION=y
CONFIG_SPL_EFI_PARTITION=y
CONFIG_EFI_PARTITION=y
CONFIG_SPL_LIBCOMMON_SUPPORT=y
CONFIG_SPL_LIBGENERIC_SUPPORT=y
# CONFIG_SPL_BANNER_PRINT is not set
CONFIG_SPL_RAW_IMAGE_SUPPORT=y
CONFIG_SPL_SHOW_ERRORS=y
CONFIG_DEBUG_UART=y
CONFIG_DEBUG_UART_MTK=y
CONFIG_DEBUG_UART_BASE=0x11002000
CONFIG_DEBUG_UART_CLOCK=26000000
CONFIG_DEBUG_UART_SKIP_INIT=y
CONFIG_BAUDRATE=921600
CONFIG_DM_SERIAL=y
CONFIG_MTK_SERIAL=y
CONFIG_CLK=y
CONFIG_MMC_MTK=y
CONFIG_ENV_IS_NOWHERE=y
# CONFIG_NET is not set
# CONFIG_EFI_LOADER is not set
# CONFIG_BOOTSTD is not set
# CONFIG_VIDEO is not set
# CONFIG_USB is not set
```
